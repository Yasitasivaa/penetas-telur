#include <Arduino.h>
#include <SPI.h>
#include <Wire.h>
#include <Adafruit_GFX.h>
#include <Adafruit_SSD1306.h>
#include <DHT.h>
#include <DHT_U.h>
#include <Servo.h>
#include <ESP8266WiFi.h>
#include <PubSubClient.h>

#define SCREEN_WIDTH 128 // OLED display width, in pixels
#define SCREEN_HEIGHT 64 // OLED display height, in pixels

// Declaration for an SSD1306 display connected to I2C (SDA, SCL pins)
Adafruit_SSD1306 display(SCREEN_WIDTH, SCREEN_HEIGHT, &Wire, -1);
Servo myServo;
DHT dht(2,DHT22);

// WiFi
const char *ssid = "vivo Y33s"; // Enter your WiFi name
const char *password = "sandisusah";  // Enter WiFi password

// MQTT Broker
const char *mqtt_broker = "192.168.77.40";
const char *mqtt_username = "emqx";
const int mqtt_port = 1883;

WiFiClient espclient;
PubSubClient Client(espclient);

// 'bilal', 128x64px
const unsigned char epd_bitmap_bilal [] PROGMEM = {
	0xff, 0xff, 0xff, 0xff, 0xff, 0xff, 0xff, 0xff, 0xff, 0xff, 0xff, 0xff, 0xff, 0xff, 0xff, 0xff, 
	0xff, 0xff, 0xff, 0xff, 0xff, 0xff, 0xff, 0xfc, 0x07, 0xff, 0xff, 0xff, 0xff, 0xff, 0xff, 0xff, 
	0xff, 0xff, 0xff, 0xff, 0xff, 0xff, 0xff, 0xf0, 0x00, 0x7f, 0xff, 0xff, 0xff, 0xff, 0xff, 0xff, 
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	0xff, 0xff, 0xff, 0x71, 0x02, 0x1c, 0xb5, 0xf4, 0x80, 0x2b, 0xd5, 0xc2, 0x7f, 0xff, 0xff, 0xff
};



// 'gali', 128x64px
const unsigned char epd_bitmap_gali [] PROGMEM = {
	0xff, 0xff, 0xff, 0xff, 0xff, 0xff, 0xff, 0xff, 0xff, 0xff, 0xff, 0xff, 0xff, 0xff, 0xff, 0xff, 
	0xff, 0xff, 0xff, 0xff, 0xff, 0xff, 0xff, 0xff, 0xff, 0xff, 0xff, 0xff, 0xff, 0xff, 0xff, 0xff, 
	0xff, 0xff, 0xff, 0xff, 0xff, 0xff, 0xff, 0x80, 0xff, 0xff, 0xff, 0xff, 0xff, 0xff, 0xff, 0xff, 
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	0xff, 0xff, 0xff, 0xff, 0xff, 0xe0, 0x81, 0xfe, 0x03, 0xc0, 0xfe, 0x62, 0x7f, 0xff, 0xff, 0xff
};

// Array of all bitmaps for convenience. (Total bytes used to store images in PROGMEM = 1040)
const int epd_bitmap_allArray_LEN = 2;
const unsigned char* epd_bitmap_allArray[2] = {
	epd_bitmap_bilal,
  	epd_bitmap_gali
};

//Variable Declaration
int T = 0.0;
int H = 0.0;
int sudut=0;
int P=0,PID_i=0,PID_d=0;
int Kp=50, Ki=30, Kd =1200;
float I;
float PID_error =0;
float previous_error =0;
float eT, Ti, tP;
float PID_value=0;
int Sp,pwm;



void callback(char* topic, byte* payload, unsigned int length) {
  Serial.print("Message arrived [");
  Serial.print(topic);
  Serial.print("] ");
  String Ms;
  for (int i = 0; i < length; i++) {
	Ms+=(char)payload[i];
  }
  Serial.println(Ms);
  myServo.write(Ms.toInt());
//  	if(topic=="servo"){
// 	Serial.print(Ms);
// 	myServo.write(Ms.toInt());
//    }
  Serial.println();
}

void reconnect(){
	String client_id = "penetas_telur";
    client_id += String(WiFi.macAddress());
    if (Client.connect(client_id.c_str())) {
		Client.subscribe("servo");
        Serial.println("Public emqx mqtt broker connected");
    } else {
        Serial.print("failed with state ");
        Serial.print(Client.state());
        delay(2000);
    }
}

void setup() {
  Serial.begin(9600);
  dht.begin();
  myServo.attach(D5);

  if(!display.begin(SSD1306_SWITCHCAPVCC, 0x3C)) { // Address 0x3D for 128x64
    Serial.println(F("SSD1306 allocation failed"));
    for(;;);
  }
  delay(2000);
  display.clearDisplay();

  display.setTextSize(1);
  display.setTextColor(WHITE);
  display.setCursor(0,0);
  // Display static text
  display.clearDisplay();
  display.drawBitmap(0, 0, epd_bitmap_gali , 128, 64, WHITE);
  display.display();
  delay(1000);
  display.clearDisplay();
  display.drawBitmap(0,0, epd_bitmap_bilal,128, 64,WHITE);
  display.display();
  display.clearDisplay();
  delay(2000);
  // connect wifi
  WiFi.begin(ssid,password);
  while(WiFi.status() != WL_CONNECTED){
    delay(500);
    Serial.println("connecting to wifi");
    display.println("connecting to wifi");
    display.display();
    display.clearDisplay();
  }
  display.println("connected");
  Client.setServer(mqtt_broker,mqtt_port);
  Client.setCallback(callback);
}


void loop() {
//   int currentmillis = millis();
//   if(currentmillis - previousMillis >= interval){
//     // get temp value
//     float newT = dht.readTemperature();
//     if(isnan(newT)){
//       Serial.println("Failed to read temp from dht");
//     }else{
//       t=newT;
//     }
//     //get humid value
//     float newH = dht.readHumidity();
//     if(isnan(newT)){
//       Serial.println("Failed to read humid from dht");
//     }else{
//       h=newH;
//     }
//   }

   if(!Client.connected()){
	reconnect();
   }
   Client.loop();
   T = dht.readTemperature();
   H = dht.readHumidity();
   PID_error=Sp-T+1;
   P = 0.01*Kp*PID_error;
   I = 0.01*I+(Ki*PID_error);
   tP=Ti;
   Ti=millis();
   eT = (Ti - tP)/1000;
   PID_d = 0.01*Kd*((PID_error-previous_error)/eT);
   PID_value=P+I+PID_d;
   if(PID_value<0){PID_value=0;}
   if(PID_value>255){PID_value=250;}
   


  display.setCursor(0,0);
  display.setTextSize(2);
  display.println("  Penetas ");display.println("   Telur  ");
  display.print("Temp = ");display.print(T);display.println("C");
  display.print("Humid= ");display.print(H);display.println("%");
  display.display();
  delay(1000);
  display.clearDisplay();
}